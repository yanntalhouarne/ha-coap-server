## application/boards/arm/hacoap/Kconfig.board
```kconfig
# Copyright (c) 2024 Nordic Semiconductor ASA
# SPDX-License-Identifier: Apache-2.0

config BOARD_HACOAP
	bool "hacoap"
	depends on SOC_NRF52840_QIAA
```

## application/boards/arm/hacoap/Kconfig.defconfig
```kconfig
# Copyright (c) 2024 Nordic Semiconductor ASA
# SPDX-License-Identifier: Apache-2.0

if BOARD_HACOAP

config BOARD
	default "hacoap"

config BT_CTLR
   default BT


endif
```
